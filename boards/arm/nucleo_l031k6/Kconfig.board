## boards/arm/nucleo_l031k6/Kconfig.board
```kconfig
# Kconfig - STM32 Nucleo development board with STM32L031K6 MCU configuration
#
# Copyright (c) 2018 INTELLINIUM <giuliano.franchetto@intellinium.com>
#
# SPDX-License-Identifier: Apache-2.0
#

config BOARD_NUCLEO_L031K6
	bool "NUCLEO-32 L031K6 Development Board"
	depends on SOC_STM32L031XZ
```

## boards/arm/nucleo_l031k6/Kconfig.defconfig
```kconfig
# Kconfig - STM32 Nucleo development board with STM32L031K6 MCU
#
# Copyright (c) 2018 INTELLINIUM <giuliano.franchetto@intellinium.com>
#
# SPDX-License-Identifier: Apache-2.0
#

if BOARD_NUCLEO_L031K6

config BOARD
	default "nucleo_l031k6"

if UART_CONSOLE

config UART_2
	default y

endif # UART_CONSOLE

if I2C

config I2C_1
	default y

endif # I2C

if SPI

config SPI_1
	default y

config SPI_STM32_INTERRUPT
	default y

endif # SPI

endif # BOARD_NUCLEO_L031K6
```

## soc/arm/st_stm32/stm32l0/Kconfig.defconfig.stm32l031xz
```kconfig
# Kconfig - ST Microelectronics STM32L031XZ MCU
#
# Copyright (c) 2018 INTELLINIUM <giuliano.franchetto@intellinium.com>
#
# SPDX-License-Identifier: Apache-2.0
#

if SOC_STM32L031XZ

config SOC
	string
	default "stm32l031xx"

config NUM_IRQS
	int
	default 32

if GPIO_STM32

config GPIO_STM32_PORTH
	default y

endif # GPIO_STM32

endif # SOC_STM32L031XZ
```
